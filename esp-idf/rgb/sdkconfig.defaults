## esp-idf/rgb/sdkconfig.defaults
```kconfig
# Configuration Zigbee pour ESP32-H2 (ESP-IDF 5.3.1)
# Note: Zigbee requires esp-zigbee-lib external component

# These configs may not be available in standard IDF 5.3.1
# CONFIG_ZB_ENABLED=y
# CONFIG_ZB_ZCZR=y
# CONFIG_ZB_ZED=y
```

## esp-idf/ws2812/sdkconfig.defaults
```kconfig
#
# Partition Table
#
CONFIG_PARTITION_TABLE_CUSTOM=y
CONFIG_PARTITION_TABLE_CUSTOM_FILENAME="partitions.csv"
CONFIG_PARTITION_TABLE_FILENAME="partitions.csv"
CONFIG_PARTITION_TABLE_OFFSET=0x8000
CONFIG_PARTITION_TABLE_MD5=y
# end of Partition Table

#
# Zboss
#
CONFIG_ZB_ENABLED=y
CONFIG_ZB_ZED=y
# end of Zboss

#
# IEEE802154
#
CONFIG_IEEE802154_RECEIVE_DONE_HANDLER=y
# end of IEEE802154
```
